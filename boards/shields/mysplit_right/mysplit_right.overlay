#include <zephyr/dt-bindings/gpio/gpio.h>


/ {
    chosen { zmk,kscan = &kscan0; };

    kscan0: kscan {
        compatible = "zmk,kscan-gpio-matrix";
        diode-direction = "row2col";

        /* Rows: 031 029 002 115 111 010 */
        row-gpios = <&gpio0 31 (GPIO_ACTIVE_LOW | GPIO_PULL_UP)>,
                    <&gpio0 29 (GPIO_ACTIVE_LOW | GPIO_PULL_UP)>,
                    <&gpio0  2 (GPIO_ACTIVE_LOW | GPIO_PULL_UP)>,
                    <&gpio1 15 (GPIO_ACTIVE_LOW | GPIO_PULL_UP)>,
                    <&gpio1 11 (GPIO_ACTIVE_LOW | GPIO_PULL_UP)>,
                    <&gpio0 10 (GPIO_ACTIVE_LOW | GPIO_PULL_UP)>;

        /* Cols: 017 020 022 024 100 011 106 */
        col-gpios = <&gpio0 17 GPIO_ACTIVE_LOW>,
                    <&gpio0 20 GPIO_ACTIVE_LOW>,
                    <&gpio0 22 GPIO_ACTIVE_LOW>,
                    <&gpio0 24 GPIO_ACTIVE_LOW>,
                    <&gpio1  0 GPIO_ACTIVE_LOW>,
                    <&gpio0 11 GPIO_ACTIVE_LOW>,
                    <&gpio1  6 GPIO_ACTIVE_LOW>;
    };
};
